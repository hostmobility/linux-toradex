/*
 * Copyright 2016 Host Mobility AB
 *
 * This program is free software; you can redistribute it and/or modify
 * it under the terms of the GNU General Public License as published by
 * the Free Software Foundation; either version 2 of the License, or
 * (at your option) any later version.
 */

/dts-v1/;
#include "vf610-mx4.dtsi"
#include "vf-mx4-c61.dtsi"

/ {
	model = "Toradex Colibri VF61 on Host Mobility MX-4 C61 board";
	compatible = "hostmobility,vf610-mx4_c61", "hostmobility,vf610-mx4_c61", "fsl,vf610";
};
