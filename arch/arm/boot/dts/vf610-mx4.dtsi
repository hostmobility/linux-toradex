/*
 * Copyright 2015 Host Mobility AB
 *
 * This program is free software; you can redistribute it and/or modify
 * it under the terms of the GNU General Public License as published by
 * the Free Software Foundation; either version 2 of the License, or
 * (at your option) any later version.
 */

#include "vf610.dtsi"
#include "vf-mx4.dtsi"

/ {
	model = "Host Mobility AB MX-4 V61";
	compatible = "hostmobility,vf610-mx4_v61", "fsl,vf610";

	memory {
		reg = <0x80000000 0x10000000>;
	};
};

&L2 {
	arm,data-latency = <2 1 2>;
	arm,tag-latency = <3 2 3>;
};
