/*
 * Copyright 2015 Host Mobility AB
 *
 * This program is free software; you can redistribute it and/or modify
 * it under the terms of the GNU General Public License as published by
 * the Free Software Foundation; either version 2 of the License, or
 * (at your option) any later version.
 */

/dts-v1/;
#include "vf610-mx4.dtsi"
#include "vf-mx4-v61.dtsi"

/ {
	model = "Toradex Colibri VF61 on Host Mobility MX-4 V61 board";
	compatible = "hostmobility,vf610-mx4_v61", "hostmobility,vf610-mx4_v61", "fsl,vf610";
};